## bike_computer/Kconfig
```kconfig
menu "Zephyr"
source "Kconfig.zephyr"
endmenu

module = APP
module-str = APP
source "subsys/logging/Kconfig.template.log_config"

config LOG_TASK_TIMES
  bool "Log task times for debugging purposes"
  default n
  help
    This option must be enabled to log task times with the TaskManager class
    This option must be disabled for test and production

config BIKE_COMPUTER_STATIC_SCHEDULING
  bool "Build system with static scheduling"
  default n
  help
    This option must be enabled to use the static scheduling version.

config BIKE_COMPUTER_STATIC_SCHEDULING_WITH_EVENT
  bool "Build system with static scheduling with event"
  default n
  help
    This option must be enabled to use the static scheduling version
    with event handling

config BIKE_COMPUTER_STATIC_SCHEDULING_WITH_WQ
  bool "Build system with static scheduling with work queue"
  default n
  help
    This option must be enabled to use the static scheduling version
    with work queue
```
